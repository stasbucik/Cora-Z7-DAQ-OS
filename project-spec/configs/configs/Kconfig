## project-spec/configs/configs/Kconfig
```kconfig
mainmenu "PetaLinux System Configuration"
config SUBSYSTEM_TYPE_LINUX
        bool
        default y
        select SYSTEM_ZYNQ

config SYSTEM_ZYNQ
        bool "ZYNQ Configuration"
        help
          ZYNQ Configuration for petalinux project.
          All these config options will be in /home/user/Cora-Z7-DAQ-OS/project-spec/configs/config

config SUBSYSTEM_SDT_FLOW
        bool
        default y
        help

config SUBSYSTEM_DISTRO_PETALINUX
        bool
        default y
        help

source /home/user/Cora-Z7-DAQ-OS/project-spec/configs/configs/Kconfig.main
```
