/include/ "system-conf.dtsi"
/ {
    daq: daq@46000000 {
		compatible = "stasbucik,daqdrv";
		reg = <0x46000000 0x4000>, <0x43c00000 0x1000>;
		interrupt-parent = <&intc>;
		// 61 - 32 = 29(10) = 1D(16)
		interrupts = <0x0 0x1D 0x1>;
	};
};
