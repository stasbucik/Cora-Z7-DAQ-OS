/ {
	amba_pl: amba_pl {
		ranges;
		compatible = "simple-bus";
		#address-cells = <1>;
		#size-cells = <1>;
		firmware-name = "CoraZ707S-0x000000100-20250610104504-matterhorn-c0f361c.bit.bin";
		clocking0: clocking0 {
			compatible = "xlnx,fclk";
			assigned-clocks = <&clkc 15>;
			assigned-clock-rates = <100000000>;
			#clock-cells = <0>;
			clock-output-names = "fabric_clk";
			clocks = <&clkc 15>;
		};
		clk_wiz_0: clk_wiz@43c20000 {
			xlnx,reset-type = "ACTIVE_HIGH";
			xlnx,pll-clkout1-divide = <1>;
			xlnx,clk-out1-port = "clk_out1";
			xlnx,clkout2-phase = <0>;
			xlnx,clkout3-jitter = <0>;
			xlnx,clkout3-drives = "BUFGCE";
			reg = <0x43c20000 0x800>;
			xlnx,use-min-o-jitter = <0>;
			xlnx,clkout4-phase-error = <0>;
			xlnx,clkout5-1 = <0000>;
			xlnx,clkout5-2 = <0000>;
			xlnx,clkout5-out-freq = <100>;
			xlnx,d-max = <80>;
			xlnx,clkout1-phase = <0>;
			xlnx,divide6-auto = <0xfa00>;
			xlnx,clkout1-jitter = <0x8917b40>;
			xlnx,clkfb-in-n-port = "clkfb_in_n";
			xlnx,clkout2-requested-out-freq = <100>;
			xlnx,use-locked = <1>;
			xlnx,pll-clkout5-duty-cycle = <0x7a120>;
			xlnx,mmcm-clkout3-use-fine-ps;
			xlnx,clkout1-drives = "BUFGCE";
			xlnx,input-clk-stopped-port = "input_clk_stopped";
			xlnx,clkout4-duty-cycle = <50>;
			xlnx,divide3-auto = <0xfa00>;
			xlnx,use-dyn-reconfig = <1>;
			xlnx,clkout3-actual-freq = <100>;
			xlnx,clkout6-requested-duty-cycle = <50>;
			xlnx,diff-clk-in1-board-interface = "Custom";
			xlnx,mmcm-clkout0-duty-cycle = <0x7a120>;
			xlnx,clkin2-jitter-ps = <100>;
			xlnx,clkout2-1 = <0000>;
			xlnx,in-freq-units = "Units_MHz";
			xlnx,clkout2-2 = <0000>;
			xlnx,feedback-source = "FDBK_AUTO";
			xlnx,clkout5-requested-out-freq = <100>;
			xlnx,name = "clk_wiz_0";
			xlnx,prim-in-freq = <100>;
			xlnx,mmcm-clkout5-divide = <1>;
			xlnx,clkout3-phase-error = <0>;
			xlnx,clk-in2-board-interface = "Custom";
			xlnx,clkin1-ui-jitter = <0x2710>;
			xlnx,use-inclk-switchover = <0>;
			clock-names = "clk_in1" , "s_axi_aclk";
			xlnx,clkout5-duty-cycle = <50>;
			xlnx,use-clkout4-bar = <0>;
			xlnx,mmcm-clkout1-duty-cycle = <0x7a120>;
			xlnx,mmcm-clkout2-use-fine-ps;
			xlnx,clkout2-out-freq = <100>;
			xlnx,use-dyn-phase-shift = <0>;
			xlnx,mmcm-clkout3-divide = <1>;
			xlnx,clkout2-actual-freq = <100>;
			xlnx,o-min = <1>;
			xlnx,daddr-port = "daddr";
			xlnx,precision = <1>;
			xlnx,mmcm-ref-jitter1 = <0x2710>;
			clock-output-names = "0x43c20000-clk_out1";
			xlnx,mmcm-ref-jitter2 = <0x2710>;
			xlnx,pll-notes = "No , notes";
			xlnx,use-phase-alignment = <1>;
			xlnx,ref-clk-freq = <100>;
			xlnx,clkout7-requested-duty-cycle = <50>;
			xlnx,inclk-sum-row0 = "Input , Clock , Freq , (MHz) , Input , Jitter , (UI)";
			xlnx,inclk-sum-row1 = "__primary_________100.000____________0.010";
			xlnx,use-fast-simulation = <0>;
			xlnx,inclk-sum-row2 = "no_secondary_input_clock";
			xlnx,mmcm-clkout1-divide = <1>;
			xlnx,din-port = "din";
			xlnx,reset-board-interface = "Custom";
			xlnx,clkout6-duty-cycle = <50>;
			xlnx,clkout2-phase-error = <0>;
			xlnx,clkout1-requested-duty-cycle = <50>;
			xlnx,vco-max = <1200>;
			xlnx,use-freq-synth = <1>;
			xlnx,primtype-sel = "AUTO";
			xlnx,mmcm-clkout2-duty-cycle = <0x7a120>;
			xlnx,clkout5-used = <0>;
			xlnx,d-min = <1>;
			xlnx,pll-clkfbout-mult = <1>;
			xlnx,mmcm-clkout4-cascade;
			xlnx,use-clkout1-bar = <0>;
			xlnx,clk-out6-port = "clk_out6";
			xlnx,clkout2-sequence-number = <1>;
			xlnx,clk-valid-port = "CLK_VALID";
			xlnx,clkout2-used = <0>;
			xlnx,clkout4-sequence-number = <1>;
			xlnx,psincdec-port = "psincdec";
			xlnx,mmcm-clkout1-use-fine-ps;
			xlnx,clk-out3-port = "clk_out3";
			xlnx,clkout6-sequence-number = <1>;
			xlnx,platform = "UNKNOWN";
			xlnx,mmcm-clkout6-phase = <0>;
			xlnx,clkout1-actual-freq = <100>;
			xlnx,clkout6-out-freq = <100>;
			xlnx,nr-outputs = <1>;
			xlnx,mmcm-clkin2-period = <10>;
			xlnx,prim-in-jitter = <0x2710>;
			xlnx,mmcm-clkfbout-mult-f = <10>;
			status = "okay";
			xlnx,clkout6-1 = <0000>;
			xlnx,clkout6-2 = <0000>;
			xlnx,clkout7-duty-cycle = <50>;
			xlnx,outclk-sum-row1 = "clk_out1__64.00000______0.000______50.0______143.752_____98.575";
			xlnx,outclk-sum-row2 = "no_CLK_OUT2_output";
			xlnx,jitter-sel = "No_Jitter";
			xlnx,outclk-sum-row3 = "no_CLK_OUT3_output";
			xlnx,mmcm-clkout5-phase = <0>;
			xlnx,mmcm-clkout3-duty-cycle = <0x7a120>;
			xlnx,outclk-sum-row4 = "no_CLK_OUT4_output";
			xlnx,clkfb-in-p-port = "clkfb_in_p";
			xlnx,outclk-sum-row5 = "no_CLK_OUT5_output";
			xlnx,outclk-sum-row6 = "no_CLK_OUT6_output";
			xlnx,outclk-sum-row7 = "no_CLK_OUT7_output";
			xlnx,clkout1-phase-error = <0x5e02298>;
			xlnx,divide5-auto = <0xfa00>;
			xlnx,pll-bandwidth = "OPTIMIZED";
			xlnx,psdone-port = "psdone";
			xlnx,clkout3-1 = <0000>;
			xlnx,edk-iptype = "PERIPHERAL";
			xlnx,clkout3-2 = <0000>;
			xlnx,clkout3-requested-out-freq = <100>;
			xlnx,pll-clkout4-divide = <1>;
			xlnx,pll-clkfbout-phase = <0>;
			xlnx,divide2-auto = <0xfa00>;
			xlnx,override-mmcm = <0>;
			xlnx,clkout6-jitter = <0>;
			xlnx,ss-mode = "CENTER_HIGH";
			xlnx,mmcm-notes = "None";
			xlnx,clkout6-drives = "BUFGCE";
			xlnx,mmcm-clkfbout-use-fine-ps;
			xlnx,mmcm-clkout0-use-fine-ps;
			xlnx,ss-mod-period = <4000>;
			xlnx,mmcm-clkout4-phase = <0>;
			xlnx,clkout2-requested-duty-cycle = <50>;
			xlnx,clkout0-actual-freq = <64>;
			xlnx,divclk = <0000>;
			xlnx,primary-port = "clk_in1";
			xlnx,mmcm-compensation = "ZHOLD";
			xlnx,clkout6-requested-out-freq = <100>;
			xlnx,clkout0-1 = <0000>;
			xlnx,clkout0-2 = <0000>;
			xlnx,clkout2-requested-phase = <0>;
			xlnx,relative-inclk = "REL_PRIMARY";
			xlnx,pll-clkout2-divide = <1>;
			xlnx,clkout4-requested-phase = <0>;
			xlnx,enable-user-clock0 = <0>;
			xlnx,filter-1 = <0000>;
			xlnx,mmcm-clkout4-duty-cycle = <0x7a120>;
			xlnx,clkout3-out-freq = <100>;
			xlnx,clkout4-jitter = <0>;
			xlnx,clkout6-requested-phase = <0>;
			xlnx,clkoutphy-requested-freq = <600>;
			xlnx,enable-user-clock1 = <0>;
			xlnx,filter-2 = <0000>;
			xlnx,ss-mod-freq = <250>;
			xlnx,in-jitter-units = "Units_UI";
			xlnx,mmcm-divclk-divide = <1>;
			xlnx,enable-user-clock2 = <0>;
			xlnx,enable-user-clock3 = <0>;
			xlnx,lock-1 = <0000>;
			xlnx,clkout4-drives = "BUFGCE";
			xlnx,lock-2 = <0000>;
			xlnx,den-port = "den";
			xlnx,lock-3 = <0000>;
			xlnx,use-safe-clock-startup = <1>;
			xlnx,mmcm-clkout3-phase = <0>;
			xlnx,dwe-port = "dwe";
			xlnx,clkfb-out-n-port = "clkfb_out_n";
			xlnx,use-max-i-jitter = <0>;
			xlnx,drdy-port = "drdy";
			xlnx,vco-min = <600>;
			xlnx,pll-clkout0-divide = <1>;
			xlnx,clkin1-jitter-ps = <100>;
			xlnx,clk-in-sel-port = "clk_in_sel";
			xlnx,use-freeze = <0>;
			xlnx,clkout2-jitter = <0>;
			xlnx,enable-pll0 = <0>;
			xlnx,enable-pll1 = <0>;
			xlnx,clkout2-drives = "BUFGCE";
			xlnx,use-inclk-stopped = <0>;
			xlnx,use-clkout3-bar = <0>;
			xlnx,use-clk-valid = <0>;
			xlnx,mmcm-clkout2-phase = <0>;
			compatible = "xlnx,clk-wiz-6.0" , "xlnx,clocking-wizard";
			xlnx,reset-port = "reset";
			xlnx,mmcm-clkout5-duty-cycle = <0x7a120>;
			xlnx,mmcm-clkout0-divide-f = <0xee6b28>;
			xlnx,pll-clkout0-duty-cycle = <0x7a120>;
			xlnx,speed-grade = <1>;
			xlnx,diff-clk-in2-board-interface = "Custom";
			xlnx,clkout3-requested-duty-cycle = <50>;
			xlnx,use-status = <0>;
			xlnx,prim-source = "Single_ended_clock_capable_pin";
			xlnx,clkout7-used = <0>;
			xlnx,use-clkfb-stopped = <0>;
			xlnx,mmcm-clkout1-phase = <0>;
			xlnx,mmcm-clkout6-divide = <1>;
			xlnx,clkout7-out-freq = <100>;
			xlnx,prim-in-timeperiod = <10>;
			xlnx,clkout4-used = <0>;
			xlnx,pll-clkin-period = <1>;
			xlnx,clk-out5-port = "clk_out5";
			xlnx,psclk-port = "psclk";
			xlnx,primitive = "MMCM";
			xlnx,clkout1-used;
			xlnx,reset-low = <0>;
			xlnx,clk-in1-board-interface = "Custom";
			xlnx,clk-out2-port = "clk_out2";
			xlnx,power-down-port = "power_down";
			xlnx,clkout7-phase-error = <0>;
			xlnx,mmcm-clkout6-duty-cycle = <0x7a120>;
			xlnx,mmcm-clkout4-divide = <1>;
			xlnx,mmcm-clkfbout-phase = <0>;
			xlnx,mmcm-clkout0-phase = <0>;
			xlnx,pll-clkout1-duty-cycle = <0x7a120>;
			xlnx,user-clk-freq0 = <100>;
			xlnx,user-clk-freq1 = <100>;
			xlnx,pll-clkout5-phase = <0>;
			xlnx,user-clk-freq2 = <100>;
			xlnx,secondary-in-jitter = <0x2710>;
			xlnx,user-clk-freq3 = <100>;
			xlnx,use-clock-sequencing = <0>;
			xlnx,secondary-source = "Single_ended_clock_capable_pin";
			xlnx,cddcdone-port = "cddcdone";
			xlnx,clkout7-phase = <0>;
			xlnx,psen-port = "psen";
			xlnx,mmcm-clkout6-use-fine-ps;
			xlnx,dclk-port = "dclk";
			xlnx,m-max = <64>;
			xlnx,outclk-sum-row0a = "Output , Output , Phase , Duty , Cycle , Pk-to-Pk , Phase";
			xlnx,clkout1-requested-out-freq = <64>;
			xlnx,clkout6-actual-freq = <100>;
			xlnx,divide7-auto = <0xfa00>;
			xlnx,outclk-sum-row0b = "Clock , Freq , (MHz) , (degrees) , (%) , Jitter , (ps) , Error , (ps)";
			xlnx,clkout4-1 = <0000>;
			xlnx,locked-port = "locked";
			xlnx,clkin2-ui-jitter = <0x2710>;
			xlnx,clkout4-2 = <0000>;
			xlnx,enable-clock-monitor = <0>;
			xlnx,mmcm-clkout2-divide = <1>;
			xlnx,ss-mod-time = <0xfa0>;
			xlnx,auto-primitive = "MMCM";
			xlnx,divide4-auto = <0xfa00>;
			xlnx,pll-clkout4-phase = <0>;
			xlnx,use-power-down = <0>;
			xlnx,mmcm-startup-wait;
			xlnx,divide1-auto = <1>;
			xlnx,clkout4-requested-duty-cycle = <50>;
			xlnx,clkout4-requested-out-freq = <100>;
			xlnx,rable = <0>;
			xlnx,optimize-clocking-structure-en = <0>;
			xlnx,clkout4-out-freq = <100>;
			xlnx,clkout6-phase = <0>;
			xlnx,num-out-clks = <1>;
			xlnx,ip-name = "clk_wiz";
			xlnx,pll-clkout2-duty-cycle = <0x7a120>;
			xlnx,clkout1-1 = <0000>;
			xlnx,clkout1-2 = <0000>;
			xlnx,clkout1-duty-cycle = <50>;
			xlnx,pll-divclk-divide = <1>;
			xlnx,clkout6-phase-error = <0>;
			xlnx,dout-port = "dout";
			xlnx,clkout1-sequence-number = <1>;
			xlnx,pll-clkout3-phase = <0>;
			xlnx,cddcreq-port = "cddcreq";
			xlnx,clkout7-requested-out-freq = <100>;
			xlnx,use-spread-spectrum = <0>;
			xlnx,clkout3-sequence-number = <1>;
			xlnx,clkout5-sequence-number = <1>;
			xlnx,summary-strings = "empty";
			xlnx,pll-compensation = "SYSTEM_SYNCHRONOUS";
			xlnx,clkout5-phase = <0>;
			xlnx,clkout7-sequence-number = <1>;
			xlnx,status-port = "STATUS";
			xlnx,clkfb-out-p-port = "clkfb_out_p";
			xlnx,mmcm-clkout5-use-fine-ps;
			xlnx,clkfb-in-port = "clkfb_in";
			xlnx,clkout5-actual-freq = <100>;
			xlnx,input-mode = "frequency";
			xlnx,interface-selection = <1>;
			xlnx,mmcm-bandwidth = "OPTIMIZED";
			xlnx,calc-done = "empty";
			xlnx,pll-clkout2-phase = <0>;
			xlnx,has-cddc = <0>;
			xlnx,power-reg = <0000>;
			xlnx,mmcm-clkin1-period = <10>;
			xlnx,pll-clkout3-duty-cycle = <0x7a120>;
			xlnx,clkout2-duty-cycle = <50>;
			xlnx,clkout4-phase = <0>;
			xlnx,pll-clkout5-divide = <1>;
			xlnx,clkout7-jitter = <0>;
			clocks = <&clkc 15>, <&clkc 15>;
			xlnx,clkout1-out-freq = <64>;
			xlnx,clkout7-drives = "BUFGCE";
			xlnx,clkout5-phase-error = <0>;
			xlnx,pll-clkout1-phase = <0>;
			xlnx,clkout5-requested-duty-cycle = <50>;
			xlnx,clkfb-in-signaling = "SINGLE";
			xlnx,enable-clkoutphy = <0>;
			xlnx,use-clkout2-bar = <0>;
			xlnx,secondary-port = "clk_in2";
			xlnx,clkout3-phase = <0>;
			xlnx,pll-clkout3-divide = <1>;
			xlnx,use-reset = <1>;
			xlnx,override-pll = <0>;
			xlnx,clkoutphy-mode = "VCO";
			xlnx,mmcm-clkout4-use-fine-ps;
			xlnx,clkout5-jitter = <0>;
			xlnx,clkout6-used = <0>;
			xlnx,m-min = <2>;
			xlnx,mmcm-clock-hold;
			xlnx,clkfb-stopped-port = "clkfb_stopped";
			xlnx,clk-out7-port = "clk_out7";
			xlnx,clkout1-requested-phase = <0>;
			xlnx,clkout4-actual-freq = <100>;
			xlnx,pll-clk-feedback = "CLKFBOUT";
			xlnx,phaseshift-mode = "WAVEFORM";
			xlnx,clkfb-out-port = "clkfb_out";
			xlnx,clkout5-drives = "BUFGCE";
			xlnx,o-max = <128>;
			xlnx,clkout3-requested-phase = <0>;
			xlnx,jitter-options = "UI";
			xlnx,secondary-in-timeperiod = <10>;
			xlnx,pll-clkout4-duty-cycle = <0x7a120>;
			xlnx,clkout3-used = <0>;
			xlnx,clkout5-requested-phase = <0>;
			xlnx,pll-clkout0-phase = <0>;
			xlnx,clk-out4-port = "clk_out4";
			xlnx,clkout3-duty-cycle = <50>;
			xlnx,clkout7-requested-phase = <0>;
			xlnx,secondary-in-freq = <100>;
			xlnx,use-min-power = <0>;
			xlnx,clkfbout-1 = <0000>;
			#clock-cells = <1>;
			xlnx,pll-ref-jitter = <0x2710>;
			xlnx,clkfbout-2 = <0000>;
			xlnx,component-name = "Infrastructure_clk_wiz_0_0";
		};
	};
};
